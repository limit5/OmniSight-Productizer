## src/embedded/typec/Kconfig
```kconfig
# SPDX-License-Identifier: GPL-2.0-only

config OMNISIGHT_RK3588_TYPEC_TCPC
	tristate "OmniSight RK3588 Type-C TCPC binding"
	depends on I2C
	depends on TYPEC
	select TYPEC_TCPM
	select TYPEC_FUSB302
	help
	  Bind the ATK-DLRK3588 Type-C controller to the upstream Linux
	  Type-C controller driver. The default controller is FUSB302, matching
	  the C5.C.0 spike and the RK3588 design assumption.

	  This shim instantiates the upstream I2C client and leaves TCPM
	  registration plus /sys/class/typec exposure to the selected upstream
	  driver. It does not implement UCSI or userspace PD contract policy.

	  HUSB311 and FUSB304 are intentionally not enabled here because the
	  C5.C.0 spike did not find a mainline-compatible driver binding for
	  those alternates. WUSB3801 may be instantiated for attach/orientation
	  smoke only, but it is not equivalent to FUSB302-class TCPM PD.

config OMNISIGHT_TYPEC_UCSI_BINDINGS
	tristate "OmniSight Type-C UCSI bindings"
	depends on TYPEC
	depends on UCSI
	help
	  Register a board-supplied UCSI transport with the upstream Linux UCSI
	  core so connector status, PD contract state, and alternate modes are
	  exposed through /sys/class/typec.

	  This is a narrow binding layer only. It does not instantiate the
	  RK3588 Type-C controller from C5.C.1 and does not implement the
	  charging daemon or userspace PD policy from C5.C.3.
```

## src/embedded/uac-gadget/Kconfig
```kconfig
config OMNISIGHT_UAC_GADGET_ALSA_WIRING
	tristate "OmniSight UAC2 ALSA PCM wiring"
	depends on SND && USB && USB_GADGET
	select SND_PCM
	select SND_USB_AUDIO
	help
	  Expose the Case 5 UAC2 gadget endpoints as ALSA PCM capture and
	  playback devices under /dev/snd. The PCM format is fixed to 48 kHz,
	  16-bit stereo so host-side snd_usb_audio sees the same defaults as
	  the UAC2 descriptor path.

choice
	prompt "OmniSight UAC2 codec hook"
	depends on OMNISIGHT_UAC_GADGET_ALSA_WIRING
	default OMNISIGHT_UAC_GADGET_CODEC_NONE
	help
	  Select the board codec hook compiled beside the UAC2 ALSA wiring.
	  RK3588 boards commonly pair with ES8388 or RT5640; board Kconfig
	  should select the option matching the device-tree audio codec.

config OMNISIGHT_UAC_GADGET_CODEC_NONE
	bool "No board codec hook"

config OMNISIGHT_UAC_GADGET_CODEC_ES8388
	bool "ES8388 board codec hook"
	depends on SND_SOC
	select SND_SOC_ES8388

config OMNISIGHT_UAC_GADGET_CODEC_RT5640
	bool "RT5640 board codec hook"
	depends on SND_SOC
	select SND_SOC_RT5640

endchoice
```

## yocto/meta-omnisight-camera/conf/layer.conf
```bitbake
# OmniSight camera Yocto layer configuration.

BBPATH .= ":${LAYERDIR}"

BBFILES += "${LAYERDIR}/recipes-*/*/*.bb \
            ${LAYERDIR}/recipes-*/*/*.bbappend"

BBFILE_COLLECTIONS += "omnisight-camera"
BBFILE_PATTERN_omnisight-camera = "^${LAYERDIR}/"
BBFILE_PRIORITY_omnisight-camera = "6"

LAYERSERIES_COMPAT_omnisight-camera = "scarthgap"
```
